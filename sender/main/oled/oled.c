#include "oled.h"
#include "esp_log.h"
#include <string.h>
#include <stdint.h>

static const char *TAG = "OLED";

static void oled_send_cmd(uint8_t cmd);
static void oled_send_data(uint8_t *data, size_t len);

static void oled_send_cmd(uint8_t cmd) {
    i2c_cmd_handle_t cmd_h = i2c_cmd_link_create();
    i2c_master_start(cmd_h);
    i2c_master_write_byte(cmd_h, (OLED_ADDR << 1) | I2C_MASTER_WRITE, true);
    i2c_master_write_byte(cmd_h, 0x00, true);  // Co = 0, D/C = 0
    i2c_master_write_byte(cmd_h, cmd, true);
    i2c_master_stop(cmd_h);
    i2c_master_cmd_begin(OLED_I2C_PORT, cmd_h, pdMS_TO_TICKS(100));
    i2c_cmd_link_delete(cmd_h);
}

static void oled_send_data(uint8_t *data, size_t len) {
    // gửi block dữ liệu (prefix 0x40)
    i2c_cmd_handle_t cmd_h = i2c_cmd_link_create();
    i2c_master_start(cmd_h);
    i2c_master_write_byte(cmd_h, (OLED_ADDR << 1) | I2C_MASTER_WRITE, true);
    i2c_master_write_byte(cmd_h, 0x40, true);  // Co = 0, D/C = 1
    i2c_master_write(cmd_h, data, len, true);
    i2c_master_stop(cmd_h);
    i2c_master_cmd_begin(OLED_I2C_PORT, cmd_h, pdMS_TO_TICKS(100));
    i2c_cmd_link_delete(cmd_h);
}

// ----- font 5x7, ASCII 32..126 (each 5 bytes) -----
static const uint8_t font5x7[][5] = {
  {0x00,0x00,0x00,0x00,0x00}, // 32  ' '
  {0x00,0x00,0x5F,0x00,0x00}, // 33  '!'
  {0x00,0x07,0x00,0x07,0x00}, // 34  '"'
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  {0x02,0x01,0x02,0x04,0x02}, //126  '~'
};

// oled_init & oled_clear remain same as before (ensure i2c init done)
esp_err_t oled_init(void) {
    i2c_config_t conf = {
        .mode = I2C_MODE_MASTER,
        .sda_io_num = OLED_SDA_PIN,
        .scl_io_num = OLED_SCL_PIN,
        .sda_pullup_en = GPIO_PULLUP_ENABLE,
        .scl_pullup_en = GPIO_PULLUP_ENABLE,
        .master.clk_speed = 400000
    };
    ESP_ERROR_CHECK(i2c_param_config(OLED_I2C_PORT, &conf));
    ESP_ERROR_CHECK(i2c_driver_install(OLED_I2C_PORT, I2C_MODE_MASTER, 0, 0, 0));

    // Lệnh khởi tạo cho SH1106
    const uint8_t init_cmds[] = {
        0xAE, // Display off
        0xD5, 0x80,
        0xA8, 0x3F,
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        0xA6,
        0xAF
    };
    for (size_t i = 0; i < sizeof(init_cmds); i++) {
        oled_send_cmd(init_cmds[i]);
    }

    ESP_LOGI(TAG, "OLED initialized");
    return ESP_OK;
}

void oled_clear(void) {
    uint8_t zero[128];
    memset(zero, 0x00, sizeof(zero));
    for (uint8_t page = 0; page < 8; page++) {
        oled_send_cmd(0xB0 + page);
        oled_send_cmd(0x02);
        oled_send_cmd(0x10);
        oled_send_data(zero, sizeof(zero));
    }
}

void oled_show_text(const char *text, uint8_t x, uint8_t y) {
    if (text == NULL) return;
    // log trước khi di con trỏ text
    ESP_LOGI(TAG, "Display text: %s", text);

    uint8_t col = 2 + x * 6; // offset 2 pixel cho SH1106
    uint8_t page = y & 0x07; // 0..7

    oled_send_cmd(0xB0 + page);
    oled_send_cmd(0x00 + (col & 0x0F));
    oled_send_cmd(0x10 + (col >> 4));

    // buffer 6 bytes: 5 font bytes + 1 spacer
    uint8_t buf[6];
    while (*text) {
        char c = *text++;
        if (c < 32 || c > 126) c = 32;
        // copy 5 bytes of font
        for (int i = 0; i < 5; i++) buf[i] = font5x7[c - 32][i];
        buf[5] = 0x00; // spacer column
        oled_send_data(buf, sizeof(buf));
    }
}
